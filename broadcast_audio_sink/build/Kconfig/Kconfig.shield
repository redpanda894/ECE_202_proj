## broadcast_audio_sink/build/Kconfig/Kconfig.shield
```kconfig
osource "c:/ncs/v2.6.0/zephyr/samples/bluetooth/broadcast_audio_sink/boards/shields/*/Kconfig.shield"
osource "C:/ncs/v2.6.0/nrf/boards/shields/*/Kconfig.shield"
```

## broadcast_audio_sink/build/Kconfig/Kconfig.shield.defconfig
```kconfig
osource "c:/ncs/v2.6.0/zephyr/samples/bluetooth/broadcast_audio_sink/boards/shields/*/Kconfig.defconfig"
osource "C:/ncs/v2.6.0/nrf/boards/shields/*/Kconfig.defconfig"
```
